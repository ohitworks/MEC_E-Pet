//
// Created by oh it works on 5/12/2023.
//
#include "project_config.h"
#include "display.hpp"
#include "expressions.hpp"

#include "U8g2lib.h"


namespace dis {

    U8G2_UC1701_MINI12864_F_4W_SW_SPI u8g2(U8G2_R0,
                                           13, 12, 11, 9, 10);

    void setup() {
        u8g2.begin();
        u8g2.setFont(u8g2_font_ncenB14_tr);
    }

    void loop(mmg::MessageManager &message_manager) {
        static mmg::MessageNode node;
        bool update = true;

        u8g2.firstPage();
        u8g2.clearDisplay();

        while (message_manager.pop(node) == 0) {
            if (mmg::is_message("ctr", node)) {
                update = true;
                switch (node.message_info) {
                    case CODE_CLEAR:
                        u8g2.clearDisplay();
                        break;
                    case CODE_EM_LAUGH:
                        u8g2.drawXBMP(0, 0, 128, 64, EM_LAUGH);
                        break;
                    case CODE_EM_SML:
                        u8g2.drawXBMP(0, 0, 128, 64, EM_SMAIL);
                        break;
                    case CODE_EM_CRY:
                        u8g2.drawXBMP(0, 0, 128, 64, EM_CRY);
                        break;
                    case CODE_EM_DIZZY:
                        u8g2.drawXBMP(0, 0, 128, 64, EM_DIZZY);
                        break;
                    case CODE_EM_WORRY:
                        u8g2.drawXBMP(0, 0, 128, 64, EM_WORRY);
                        break;
                    default:
                        update = false;
                        break;
                }
            }
            if (update) {
                u8g2.nextPage();
                delay(SCREEN_REST_TIME);
            }
        }
    }
}

#ifndef IS_MAIN
#include <Arduino.h>
#include <U8g2lib.h>

#ifdef U8X8_HAVE_HW_SPI
#include <SPI.h>
#endif
#ifdef U8X8_HAVE_HW_I2C
#include <Wire.h>
#endif

U8G2_UC1701_MINI12864_F_4W_SW_SPI u8g2(U8G2_R0,
                                       13, 12, 11, 9, 10);
#define bmp1_x 128
#define bmp1_y 64

static const unsigned char bmp1[] U8X8_PROGMEM = {
0x00,0x00,0x00,0x00,0x00,0x00,0x00,0x00,0x00,0x00,0x00,0x00,0x00,0x00,0x00,0x00,0x00,0x00,0x00,0x00,0x00,0x00,0x00,0x00,0x00,0x00,0x00,0x00,0x00,0x00,0x00,0x00,
0x00,0x00,0x00,0x00,0x00,0x00,0x00,0x00,0x00,0x00,0x00,0x00,0x00,0x00,0x00,0x00,0x00,0x00,0x00,0x00,0x00,0x00,0x00,0x00,0x00,0x00,0x00,0x00,0x00,0x00,0x00,0x00,
0x00,0x00,0x00,0x00,0x00,0x00,0x00,0x00,0x00,0x00,0x00,0x00,0x00,0x00,0x00,0x00,0x00,0x00,0x00,0x00,0x00,0x00,0x00,0x00,0x00,0x00,0x00,0x00,0x00,0x00,0x00,0x00,
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0x00,0x00,0x00,0x00,0x00,0x00,0x00,0x00,0x00,0x00,0x00,0x00,0x00,0x00,0x00,0x00,0x00,0x00,0x00,0x00,0x00,0x00,0x00,0x00,0x00,0x00,0x00,0x00,0x00,0x00,0x00,0x00,
};

void setup(void) {
  u8g2.begin();
}

void loop(void) {
  u8g2.firstPage();
  do {
    u8g2.setFont(u8g2_font_ncenB14_tr);
    u8g2.drawXBMP(0,0, bmp1_x, bmp1_y, bmp1);
  } while ( u8g2.nextPage() );
  delay(500);
}


#endif
